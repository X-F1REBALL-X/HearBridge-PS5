## tools/esp32-sink/components/usb_in/Kconfig
```kconfig
menu "USB In"

config USB_IN_SAMPLE_RATE
    int "USB input sample rate (Hz)"
    default 48000
    help
        Sample rate for audio frames received from the host.

config USB_IN_CHANNEL_COUNT
    int "USB input channel count"
    default 2
    range 1 8
    help
        Number of PCM channels delivered over USB audio.

config USB_IN_BIT_DEPTH
    int "USB input bit depth"
    default 16
    range 8 32
    help
        Bits per PCM sample; must be divisible by 8.

config USB_IN_PCM_BUFFER_SIZE
    int "PCM ring buffer size (bytes)"
    default 8192
    help
        Capacity of the FreeRTOS ring buffer storing PCM audio.

endmenu

menu "PS5 UAC1 sink USB identity"

config UAC_SINK_VID
    hex "USB VID"
    default 0x303A

config UAC_SINK_PID
    hex "USB PID"
    default 0x4011

config UAC_SINK_MANUFACTURER
    string "USB manufacturer string"
    default "ESP32"

config UAC_SINK_PRODUCT
    string "USB product string"
    default "PS5 Audio Sink"

config UAC_SINK_SERIAL
    string "USB serial string"
    default "000001"

endmenu
```

## tools/esp32-sink/sdkconfig.defaults
```kconfig
CONFIG_IDF_TARGET="esp32s3"

# Flash: N16R8 = 16MB QIO
CONFIG_ESPTOOLPY_FLASHMODE_QIO=y
CONFIG_ESPTOOLPY_FLASHSIZE_16MB=y
CONFIG_ESPTOOLPY_FLASHSIZE="16MB"
CONFIG_PARTITION_TABLE_CUSTOM=y
CONFIG_PARTITION_TABLE_CUSTOM_FILENAME="partitions.csv"

# PSRAM: 8MB octal
CONFIG_SPIRAM=y
CONFIG_SPIRAM_MODE_OCT=y
CONFIG_SPIRAM_SPEED_80M=y

# Console stays on UART0 (CP2102 port); OTG port is the UAC device
CONFIG_ESP_CONSOLE_UART_DEFAULT=y
CONFIG_ESP_DEFAULT_CPU_FREQ_MHZ_240=y
CONFIG_FREERTOS_HZ=1000

# USB identity (generic UAC1 speaker)
CONFIG_UAC_SINK_VID=0x303A
CONFIG_UAC_SINK_PID=0x4011
CONFIG_UAC_SINK_MANUFACTURER="ESP32"
CONFIG_UAC_SINK_PRODUCT="PS5 Audio Sink"
CONFIG_UAC_SINK_SERIAL="000001"

# usb_in (vendored netham45 driver)
CONFIG_USB_IN_SAMPLE_RATE=48000
CONFIG_USB_IN_CHANNEL_COUNT=2
CONFIG_USB_IN_BIT_DEPTH=16
CONFIG_USB_IN_PCM_BUFFER_SIZE=16384
```
